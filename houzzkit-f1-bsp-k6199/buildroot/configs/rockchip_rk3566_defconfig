## houzzkit-f1-bsp-k6199/buildroot/configs/rockchip_rk3566_defconfig
```kconfig
#include "base/base.config"
#include "chips/rk3566_rk3568_aarch64.config"
#include "font/chinese.config"
#include "fs/exfat.config"
#include "fs/ntfs.config"
#include "fs/vfat.config"
#include "gpu/gpu.config"
#include "multimedia/audio.config"
#include "multimedia/camera.config"
#include "multimedia/gst/audio.config"
#include "multimedia/gst/camera.config"
#include "multimedia/gst/rtsp.config"
#include "multimedia/gst/video.config"
#include "multimedia/mpp.config"
#include "wifibt/bt.config"
#include "wifibt/wireless.config"
#include "wifibt/network.config"
#include "debug2.config"
#include "tools/benchmark.config"
#include "tools/common.config"
#include "tools/test.config"
#include "chromium.config"
#include "npu2.config"
#include "powermanager.config"
#include "weston.config"
BR2_PACKAGE_FIREFLY=y
BR2_PACKAGE_QUECTEL_CM=y
BR2_PACKAGE_UTIL_LINUX_BINARIES=y
BR2_TARGET_TZ_ZONELIST=y
BR2_TARGET_TZ_INFO=y
BR2_PACKAGE_TZDATA=y
BR2_TARGET_LOCALTIME="Etc/UTC"
```

## houzzkit-f1-bsp-k6199/buildroot/package/firefly/Config.in
```kconfig
menuconfig BR2_PACKAGE_FIREFLY
	bool "Firefly packages"

if BR2_PACKAGE_FIREFLY
source "package/firefly/quectel-CM/Config.in"

endif
```

## houzzkit-f1-bsp-k6199/kernel-6.1/drivers/net/wireless/rockchip_wlan/rtl88x2ce/Kconfig
```kconfig
config RTL88x2CE
	tristate "Realtek 88x2C PCIE WiFi"
	depends on PCI
	help
	  Help message of RTL88x2CE
```

## houzzkit-f1-bsp-k6199/yocto/meta-lts-mixins/conf/layer.conf
```bitbake
# We have a conf and classes directory, but we have classes that should
# override those in oe-core, so prepend to BBPATH
BBPATH =. "${LAYERDIR}:"

# We have a recipes directory, add to BBFILES
BBFILES += "${LAYERDIR}/recipes*/*/*.bb ${LAYERDIR}/recipes*/*/*.bbappend"

BBFILE_COLLECTIONS += "lts-rust-mixin"
BBFILE_PATTERN_lts-rust-mixin := "^${LAYERDIR}/"
BBFILE_PRIORITY_lts-rust-mixin = "6"

LAYERSERIES_COMPAT_lts-rust-mixin = "kirkstone"

LAYERDEPENDS_lts-rust-mixin = "core"

RUSTVERSION ?= "1.68%"

# This is not ideal, but it seems better to mask out the older oe-core
# recipes completely since they will not work with this layer on top,
# and several of them result in parse warnings.
BBMASK:append = " meta/recipes-devtools/cargo/ meta/recipes-devtools/rust/ meta/recipes-gnome/librsvg"

# These are in bitbake.conf in langdale and up, adding them here to make
# using the layer more turn-key seems reasonable.
BB_BASEHASH_IGNORE_VARS:append = " RUST_BUILD_SYS RUST_HOST_SYS RUST_TARGET_SYS"

# Since we cannot overlay the lib/oe version easily, make sure our backport
# of rust.py in lib/mixin is picked up.
OE_EXTRA_IMPORTS:append = " mixin.rust"
```

## houzzkit-f1-bsp-k6199/yocto/meta-rockchip/conf/machine/aio-3566-jd4-kernel5-10.conf
```bitbake
# Copyright (c) 2020, Rockchip Electronics Co., Ltd
# Released under the MIT license (see COPYING.MIT for the terms)

#@TYPE: Machine
#@NAME: AIO-3566-JD4

require conf/machine/firefly-rk356x-kernel5-10.conf
require conf/machine/include/common.conf
require conf/machine/include/demo.conf

KERNEL_DEVICETREE = "rockchip/rk3566-firefly-aiojd4.dtb"

UBOOT_MACHINE = "rk3568_defconfig rk3566.config"
```

## houzzkit-f1-bsp-k6199/yocto/meta-rockchip/conf/machine/aio-3568j-kernel5-10.conf
```bitbake
# Copyright (c) 2020, Rockchip Electronics Co., Ltd
# Released under the MIT license (see COPYING.MIT for the terms)

#@TYPE: Machine
#@NAME: AIO-3568J

require conf/machine/firefly-rk356x-kernel5-10.conf
require conf/machine/include/common.conf
require conf/machine/include/demo.conf

KERNEL_DEVICETREE = "rockchip/rk3568-firefly-aioj.dtb"
```

## houzzkit-f1-bsp-k6199/yocto/meta-rockchip/conf/machine/aio-3568j.conf
```bitbake
# Copyright (c) 2020, Rockchip Electronics Co., Ltd
# Released under the MIT license (see COPYING.MIT for the terms)

#@TYPE: Machine
#@NAME: AIO-3568J

require conf/machine/firefly-rk356x.conf
require conf/machine/include/common.conf
require conf/machine/include/demo.conf

KERNEL_DEVICETREE = "rockchip/rk3568-firefly-aioj.dtb"
```

## houzzkit-f1-bsp-k6199/yocto/meta-rockchip/conf/machine/firefly-rk356x.conf
```bitbake
# Copyright (c) 2020, Rockchip Electronics Co., Ltd
# Released under the MIT license (see COPYING.MIT for the terms)

#@TYPE: Machine
#@NAME: Firefly RK356X

require conf/machine/include/rk356x.inc
require conf/machine/include/firefly.inc

FIREFLY_SDK_BRANCH = "rk356x/firefly"
FIREFLY_SDK_VERSION = "rk356x/linux_yocto_release"

KBUILD_DEFCONFIG = "firefly_linux_defconfig"
KBUILD_DEFCONFIG_FRAGMENTS = ""

UBOOT_MACHINE = "firefly-rk3568_defconfig"

LINUX_VERSION = "4.19"

FF_EXTBOOT = "true"
FF_EXTBOOT_SIZE = "128M"

RK_PRODUCT_MODEL_PATH = "${TOPDIR}/../../meta-rockchip/conf/machine"

RK_OVERLAY_DIRS = "${TOPDIR}/../../meta-rockchip/overlay-firefly"

RK_RECOVERY_RAMDISK = "rk356x-recovery-arm64.cpio.gz"

RK_MISC = "wipe_all-misc.img"

DISTRO_FEATURES:append = " systemd pam"
VIRTUAL-RUNTIME_init_manager = "systemd"

RK_WIFIBT_FIRMWARES = " \
	rkwifibt-firmware \
	brcm-tools \
"

MACHINE_EXTRA_RRECOMMENDS:append = " \
	drm-cursor \
	networkmanager \
	resize-helper \
	adbd \
	bt-service \
"

NETWORK_MANAGER = "networkmanager"

PACKAGE_CLASSES = "package_deb"
EXTRA_IMAGE_FEATURES += "package-management"

BB_NUMBER_THREADS = "4"
PARALLEL_MAKE = "-j 4"
```

## houzzkit-f1-bsp-k6199/yocto/meta-rockchip/conf/machine/include/firefly.inc
```bitbake
KERNEL_RELEASE              ?= "NULL"
RKBIN_RELEASE               ?= "NULL"
TOOLS_RELEASE               ?= "NULL"
UBOOT_RELEASE               ?= "NULL"
RKWIFIBT_RELEASE            ?= "NULL"
ALSAS_CONFIG_RELEASE        ?= "NULL"
GSTREAMER_ROCKCHIP_RELEASE  ?= "NULL"
MPP_RELEASE                 ?= "NULL"
CAMERA_ENGINE_RKISP         ?= "NULL"
CAMERA_ENGINE_RKAIQ         ?= "NULL"
LINUX_RGA                   ?= "NULL"
LIBMALI                     ?= "NULL"


RK_WIFIBT_RRECOMMENDS = " \
	rkwifibt-firmware \
	brcm-tools \
"

# firefly
IMAGE_INSTALL:append = " \
	rktoolkit \
	bash-completion \
	net-tools \
	alsa-utils \
	vim \
	v4l-utils \
	iptables \
	rfkill \
	usbutils \
	clinfo \
	htop \
	rsync \
	netcat \
	stress \
	stressapptest \
	figlet \
	parted \
	ca-certificates \
	curl \
	file \
	python3 \
	upower \
	eject \
	fbset \
	unzip \
	zip \
	logrotate \
	ethtool \
	iperf3 \
	i2c-tools \
	psmisc \
	procps \
	strace \
	ldd \
	glibc-utils \
	sudo \
	sed \
	rockchip-npu \
	firefly-wdt \
	syslog-ng \
"

#IMAGE_INSTALL:append = " locale-base-zh-cn locale-base-zh-tw"

# install glibc locale
#GLIBC_GENERATE_LOCALES = "en_US.UTF-8 zh_CN.UTF-8 zh_TW.UTF-8"

# install locale-base 
#IMAGE_LINGUAS = "en-us zh-cn zh-tw"


INHERIT += "extrausers"
EXTRA_USERS_PARAMS += " \
	usermod -p '\$1\$N173a03l\$lVFl5NjiEQlx/ojFt6omS/' root; \
	useradd -p '\$1\$N173a03l\$lVFl5NjiEQlx/ojFt6omS/' -G wheel,users -d /home/firefly -m firefly; \
	usermod -aG sudo firefly; \
"
```

## houzzkit-f1-bsp-k6199/yocto/meta-rockchip/conf/machine/include/rk356x-kernel5-10.inc
```bitbake
# Copyright (c) 2020, Rockchip Electronics Co., Ltd
# Released under the MIT license (see COPYING.MIT for the terms)

require conf/machine/include/rockchip-arm64-common.inc

SOC_FAMILY := "rk3568"

PREFERRED_VERSION_linux-rockchip := "5.10%"
LINUXLIBCVERSION := "5.10-custom%"

MALI_GPU := "bifrost-g52"
MALI_VERSION := "g13p0"

RK_ISP_VERSION := "2.1"
```

## houzzkit-f1-bsp-k6199/yocto/meta-rockchip/conf/machine/itx-3568jq.conf
```bitbake
# Copyright (c) 2020, Rockchip Electronics Co., Ltd
# Released under the MIT license (see COPYING.MIT for the terms)

#@TYPE: Machine
#@NAME: ITX-3568JQ

require conf/machine/firefly-rk356x.conf
require conf/machine/include/common.conf
require conf/machine/include/demo.conf

KERNEL_DEVICETREE = "rockchip/rk3568-firefly-itx-3568q.dtb"
```

## houzzkit-f1-bsp-k6199/yocto/meta-rockchip/conf/machine/roc-rk3566-pc-kernel5-10.conf
```bitbake
# Copyright (c) 2020, Rockchip Electronics Co., Ltd
# Released under the MIT license (see COPYING.MIT for the terms)

#@TYPE: Machine
#@NAME: ROC-RK3566-PC

require conf/machine/firefly-rk356x-kernel5-10.conf
require conf/machine/include/common.conf
require conf/machine/include/demo.conf

KERNEL_DEVICETREE = "rockchip/rk3566-firefly-roc-pc.dtb"

UBOOT_MACHINE = "rk3568_defconfig rk3566.config"
```

## houzzkit-f1-bsp-k6199/yocto/meta-rockchip/conf/machine/roc-rk3566-pc.conf
```bitbake
# Copyright (c) 2020, Rockchip Electronics Co., Ltd
# Released under the MIT license (see COPYING.MIT for the terms)

#@TYPE: Machine
#@NAME: ROC-RK3566-PC

require conf/machine/firefly-rk356x.conf
require conf/machine/include/common.conf
require conf/machine/include/demo.conf

KERNEL_DEVICETREE = "rockchip/rk3566-firefly-roc-pc.dtb"

UBOOT_MACHINE = "firefly-rk3566.defconfig"
```

## houzzkit-f1-bsp-k6199/yocto/meta-rockchip/conf/machine/roc-rk3568-pc-kernel5-10.conf
```bitbake
# Copyright (c) 2020, Rockchip Electronics Co., Ltd
# Released under the MIT license (see COPYING.MIT for the terms)

#@TYPE: Machine
#@NAME: ROC-RK3568-PC

require conf/machine/firefly-rk356x-kernel5-10.conf
require conf/machine/include/common.conf
require conf/machine/include/demo.conf

KERNEL_DEVICETREE = "rockchip/rk3568-firefly-roc-pc.dtb"
```
